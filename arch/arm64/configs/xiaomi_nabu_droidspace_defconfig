## arch/arm64/configs/xiaomi_nabu_droidspace_defconfig
```kconfig
# Xiaomi Pad 5 (nabu) DroidSpaces Kernel Configuration
# Optimized for Linux container support with DroidSpaces
# Based on official DroidSpaces OSS requirements:
# https://github.com/ravindu644/Droidspaces-OSS

# ============================================
# Base System Configuration
# ============================================
CONFIG_LOCALVERSION="-droidspace-nabu"
CONFIG_MODULES=y
CONFIG_MODULE_UNLOAD=y
CONFIG_MODULE_FORCE_UNLOAD=y
CONFIG_MODVERSIONS=y
CONFIG_MODULE_SIG=n
CONFIG_MODULE_SIG_FORCE=n

# ============================================
# GKI Kernel Essentials
# ============================================
CONFIG_SYSVIPC=y
CONFIG_POSIX_MQUEUE=y

# ============================================
# ARM64 Architecture (Qualcomm SM8150)
# ============================================
CONFIG_ARCH_SM8150=y
CONFIG_ARCH_XIAOMI=y
CONFIG_ARM64=y
CONFIG_64BIT=y
CONFIG_ARCH_PHYS_ADDR_T_64BIT=y
CONFIG_MMU=y
CONFIG_NO_HZ=y
CONFIG_HIGH_RES_TIMERS=y
CONFIG_PREEMPT=y
CONFIG_HZ_300=y
CONFIG_HZ=300
CONFIG_SCHED_HRTICK=y
CONFIG_NR_CPUS=8
CONFIG_HOTPLUG_CPU=y
CONFIG_SCHED_MC=y
CONFIG_TASK_SIZE=0x0000000000000000
CONFIG_VMAP_STACK=y
CONFIG_CC_STACKPROTECTOR_REGULAR=y

# ============================================
# DroidSpaces: Namespaces (Required - Fatal)
# ============================================
CONFIG_NAMESPACES=y
CONFIG_UTS_NS=y
CONFIG_IPC_NS=y
CONFIG_USER_NS=y
CONFIG_PID_NS=y
CONFIG_NET_NS=y
CONFIG_CGROUP_NS=y
CONFIG_TIME_NS=y

# ============================================
# DroidSpaces: Cgroups (Required - Fatal)
# ============================================
CONFIG_CGROUPS=y
CONFIG_CGROUP_DEVICE=y

# ============================================
# DroidSpaces: Cgroups (Recommended)
# ============================================
CONFIG_CGROUP_PIDS=y
CONFIG_MEMCG=y
CONFIG_CGROUP_SCHED=y
CONFIG_FAIR_GROUP_SCHED=y
CONFIG_CGROUP_FREEZER=y
CONFIG_CGROUP_NET_PRIO=y

# ============================================
# DroidSpaces: Additional Cgroup Features
# ============================================
CONFIG_CPUSETS=y
CONFIG_CPUSET_CPUS_ENABLED=y
CONFIG_CPUSET_MEM_ENABLED=y
CONFIG_CPUSET_CPUAFFINITY=y
CONFIG_CGROUP_CPUACCT=y
CONFIG_MEMCG_SWAP=y
CONFIG_MEMCG_SWAP_ENABLED=y
CONFIG_MEMCG_KMEM=y
CONFIG_CGROUP_RDMA=y
CONFIG_CGROUP_PERF=y
CONFIG_CGROUP_HUGETLB=y
CONFIG_CGROUP_WRITEBACK=y
CONFIG_BLK_CGROUP=y
CONFIG_CGROUP_SCPS=y
CONFIG_CGROUP_FAVORDYNQ=y

# ============================================
# DroidSpaces: Seccomp (Required - Fatal)
# ============================================
CONFIG_SECCOMP=y
CONFIG_SECCOMP_FILTER=y

# ============================================
# DroidSpaces: Device & Filesystem (Required - Fatal)
# ============================================
CONFIG_DEVTMPFS=y
CONFIG_DEVTMPFS_MOUNT=y

# ============================================
# DroidSpaces: Firmware Loader (Recommended)
# ============================================
CONFIG_FW_LOADER=y
CONFIG_FW_LOADER_USER_HELPER=y
CONFIG_FW_LOADER_COMPRESS=y

# ============================================
# DroidSpaces: Checkpoint/Restore
# ============================================
CONFIG_CHECKPOINT_RESTORE=y

# ============================================
# DroidSpaces: Resource Limits
# ============================================
CONFIG_RESOURCE_COUNTERS=y
CONFIG_PID_IN_USERPID_NAMESPACE=y
CONFIG_NSFS=y

# ============================================
# Filesystem Support
# ============================================

# OverlayFS (Required for container layers)
CONFIG_OVERLAY_FS=y
CONFIG_OVERLAY_FS_REDIRECT_DIR=y
CONFIG_OVERLAY_FS_INDEX=y
CONFIG_OVERLAY_FS_METACOPY=y
CONFIG_OVERLAY_FS_OVERRIDE_ORIGIN=y

# Tmpfs (Required for container layers)
CONFIG_TMPFS=y
CONFIG_TMPFS_POSIX_ACL=y
CONFIG_TMPFS_XATTR=y
CONFIG_TMPFS_QUOTA=y

# Standard filesystems
CONFIG_EXT4_FS=y
CONFIG_EXT4_FS_POSIX_ACL=y
CONFIG_EXT4_FS_SECURITY=y
CONFIG_EXT4_ENCRYPTION=y
CONFIG_EXT4_FS_ENCRYPTION=y

CONFIG_BTRFS_FS=y
CONFIG_BTRFS_FS_POSIX_ACL=y
CONFIG_BTRFS_FS_CHECK_INTEGRITY=y

CONFIG_XFS_FS=y
CONFIG_XFS_POSIX_ACL=y
CONFIG_XFS_RT=y
CONFIG_XFS_QUOTA=y

CONFIG_FUSE_FS=y
CONFIG_CUSE=y
CONFIG_VIRTIO_FS=y

# proc and sysfs
CONFIG_PROC_FS=y
CONFIG_SYSFS=y

# ============================================
# DroidSpaces: Network Isolation (NAT Mode)
# ============================================
CONFIG_NET=y
CONFIG_INET=y
CONFIG_IPV6=y

# Core virtual networking
CONFIG_VETH=y
CONFIG_BRIDGE=y

# Netfilter core
CONFIG_NETFILTER=y
CONFIG_NETFILTER_ADVANCED=y
CONFIG_BRIDGE_NETFILTER=y

# Connection tracking
CONFIG_NF_CONNTRACK=y
CONFIG_NF_CONNTRACK_IPV4=y
CONFIG_NF_CONNTRACK_IPV6=y
CONFIG_NF_CONNTRACK_NETLINK=y

# iptables
CONFIG_IP_NF_IPTABLES=y
CONFIG_IP_NF_FILTER=y
CONFIG_IP_NF_NAT=y
CONFIG_IP_NF_TARGET_MASQUERADE=y
CONFIG_IP6_NF_IPTABLES=y
CONFIG_IP6_NF_FILTER=y
CONFIG_IP6_NF_TARGET_NFLOG=y
CONFIG_IP6_NF_MANGLE=y
CONFIG_IP6_NF_RAW=y
CONFIG_IP6_NF_NAT=y

# nftables
CONFIG_NF_TABLES=y

# NAT
CONFIG_NF_NAT=y
CONFIG_NF_NAT_IPV4=y
CONFIG_NF_NAT_MASQUERADE_IPV4=y
CONFIG_NF_NAT_REDIRECT=y

# xtables targets & matches
CONFIG_NETFILTER_XT_TARGET_MASQUERADE=y
CONFIG_NETFILTER_XT_TARGET_TCPMSS=y
CONFIG_NETFILTER_XT_MATCH_ADDRTYPE=y
CONFIG_NETFILTER_XT_MATCH_CONNTRACK=y

# Advanced routing
CONFIG_IP_ADVANCED_ROUTER=y
CONFIG_IP_MULTIPLE_TABLES=y

# Additional network devices
CONFIG_VLAN_8021Q=y
CONFIG_MACVLAN=y
CONFIG_DUMMY=y
CONFIG_TUN=y
CONFIG_VTUN=y
CONFIG_IP_TUNNEL=y
CONFIG_NET_IPIP=y
CONFIG_NET_IPGRE=y
CONFIG_NET_IPGRE_DEMUX=y
CONFIG_STP=y
CONFIG_LLC=y
CONFIG_NET_SCHED=y
CONFIG_NET_CLS_ACT=y
CONFIG_NET_SCH_FIFO=y

# Network diagnostics
CONFIG_INET_DIAG=y
CONFIG_INET_TCP_DIAG=y
CONFIG_UDP_DIAG=y
CONFIG_UNIX_DIAG=y
CONFIG_PACKET_DIAG=y
CONFIG_NETLINK_DIAG=y

# ============================================
# DroidSpaces: Disable Android Paranoid Networking
# ============================================
CONFIG_ANDROID_PARANOID_NETWORK=n

# ============================================
# Device Drivers
# ============================================

# Block devices
CONFIG_BLK_DEV_LOOP=y
CONFIG_BLK_DEV_LOOP_MIN_COUNT=8
CONFIG_BLK_DEV_NBD=y
CONFIG_BLK_DEV_RAM=y
CONFIG_BLK_DEV_RAM_SIZE=65536

# USB support
CONFIG_USB_SUPPORT=y
CONFIG_USB=y
CONFIG_USB_ANNOUNCE_NEW_DEVICES=y
CONFIG_USB_EHCI_HCD=y
CONFIG_USB_EHCI_ROOT_HUB_TT=y
CONFIG_USB_XHCI_HCD=y
CONFIG_USB_STORAGE=y
CONFIG_USB_SERIAL=y
CONFIG_USB_SERIAL_GENERIC=y

# Storage controllers
CONFIG_SCSI=y
CONFIG_BLK_DEV_SD=y
CONFIG_CHR_DEV_SG=y

# Input devices
CONFIG_INPUT_EVDEV=y
CONFIG_INPUT_UINPUT=y

# ============================================
# Security Modules
# ============================================
CONFIG_SECURITY=y
CONFIG_SECURITY_NETWORK=y
CONFIG_SECURITY_NETWORK_XFRM=y
CONFIG_DEFAULT_SECURITY_DAC=y
CONFIG_SECURITY_APPARMOR=y
CONFIG_SECURITY_APPARMOR_BOOTPARAM_VALUE=1
CONFIG_SECURITY_CAPABILITY=y

# ============================================
# Android Specific
# ============================================
CONFIG_ANDROID=y
CONFIG_ANDROID_BINDER_IPC=y
CONFIG_ANDROID_BINDERFS=y
CONFIG_ASHMEM=y
CONFIG_ANDROID_LOW_MEMORY_KILLER=y
CONFIG_ANDROID_LOGGER=y

# ============================================
# Kernel Debugging (Optional but useful)
# ============================================
CONFIG_DEBUG_INFO=y
CONFIG_DEBUG_INFO_DWARF5=y
CONFIG_DEBUG_INFO_REDUCED=n
CONFIG_DEBUG_FS=y
CONFIG_MAGIC_SYSRQ=y
CONFIG_DEBUG_KERNEL=y

# ============================================
# Compiler Optimizations
# ============================================
CONFIG_CC_OPTIMIZE_FOR_PERFORMANCE=y
# CONFIG_CC_OPTIMIZE_FOR_SIZE is not set

# ============================================
# Power Management
# ============================================
CONFIG_PM=y
CONFIG_PM_SLEEP=y
CONFIG_PM_RUNTIME=y
CONFIG_PM_ADVANCED_DEBUG=y

# ============================================
# Hardware Support (Xiaomi Pad 5 specific)
# ============================================

# Display
CONFIG_DRM=y
CONFIG_DRM_MSM=y
CONFIG_DRM_SDE=y
CONFIG_DRM_PANEL_SIMPLE=y
CONFIG_DRM_PANEL_SAMSUNG_S6E3FC2X01=y

# Audio
CONFIG_SND=y
CONFIG_SND_SOC=y
CONFIG_SND_SOC_SM8150=y
CONFIG_SND_SOC_WCD934X=y

# WiFi
CONFIG_NETDEVICES=y
CONFIG_WLAN=y
CONFIG_WLAN_VENDOR_PRESENT=y
CONFIG_BRCMFMAC=m
CONFIG_CFG80211=m
CONFIG_MAC80211=m

# Bluetooth
CONFIG_BT=y
CONFIG_BT_RFCOMM=y
CONFIG_BT_RFCOMM_TTY=y
CONFIG_BT_BNEP=y
CONFIG_BT_HIDP=y
CONFIG_BT_HCIBTUSB=y
CONFIG_BT_HCIUART=y
CONFIG_BT_HCIUART_H4=y

# Sensors
CONFIG_IIO=y
CONFIG_IIO_BUFFER=y
CONFIG_IIO_TRIGGERED_BUFFER=y

# Power supply
CONFIG_POWER_SUPPLY=y
CONFIG_BATTERY_QCOM_BMS=y
CONFIG_CHARGER_QCOM_SMB5=y

# ============================================
# General System Configuration
# ============================================
CONFIG_AUDIT=y
CONFIG_AUDITSYSCALL=y
CONFIG_BASE_FULL=y
CONFIG_FUTEX=y
CONFIG_FUTEX_PI=y
CONFIG_EPOLL=y
CONFIG_SIGNALFD=y
CONFIG_TIMERFD=y
CONFIG_EVENTFD=y
CONFIG_SHMEM=y
CONFIG_AIO=y
CONFIG_INOTIFY_USER=y
CONFIG_INOTIFY_INODE2USER=y
CONFIG_QUOTA=y
CONFIG_QUOTA_NETLINK_INTERFACE=y
CONFIG_PRINTK=y
CONFIG_BUG=y
CONFIG_ELF_CORE=y
CONFIG_STACKPROTECTOR=y
CONFIG_STACKPROTECTOR_STRONG=y
CONFIG_CC_STACKPROTECTOR_STRONG=y
CONFIG_READABLE_ASM=y
CONFIG_UID16=y
CONFIG_MULTIUSER=y
CONFIG_SYSCTL_EXCEPTION_TRACE=y
CONFIG_EXPERT=y
CONFIG_SYSCTL=y
CONFIG_SYSCTL_SYSCALL=y
CONFIG_KALLSYMS=y
CONFIG_KALLSYMS_ALL=y
CONFIG_KALLSYMS_UNCOMPRESSED=y
CONFIG_PRINTK_TIME=y
CONFIG_BOOT_PRINTK_DELAY=y
CONFIG_DYNAMIC_DEBUG=y
CONFIG_DEBUG_BUGVERBOSE=y
CONFIG_FRAME_POINTER=y

# ============================================
# Compression
# ============================================
CONFIG_KERNEL_GZIP=y
# CONFIG_KERNEL_LZ4 is not set
# CONFIG_KERNEL_XZ is not set
# CONFIG_KERNEL_LZO is not set
```
